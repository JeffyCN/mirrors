## drivers/dma-buf/Kconfig
```kconfig
menu "DMABUF options"

config DMABUF_CACHE
	bool "DMABUF cache attachment"
	default ARCH_ROCKCHIP
	help
	  This option support to store attachments in a list and destroy them by
	  set to a callback list in the dtor of dma-buf.

config SYNC_FILE
	bool "Explicit Synchronization Framework"
	default n
	select DMA_SHARED_BUFFER
	---help---
	  The Sync File Framework adds explicit syncronization via
	  userspace. It enables send/receive 'struct dma_fence' objects to/from
	  userspace via Sync File fds for synchronization between drivers via
	  userspace components. It has been ported from Android.

	  The first and main user for this is graphics in which a fence is
	  associated with a buffer. When a job is submitted to the GPU a fence
	  is attached to the buffer and is transferred via userspace, using Sync
	  Files fds, to the DRM driver for example. More details at
	  Documentation/sync_file.txt.

config SW_SYNC
	bool "Sync File Validation Framework"
	default n
	depends on SYNC_FILE
	---help---
	  A sync object driver that uses a 32bit counter to coordinate
	  synchronization.  Useful when there is no hardware primitive backing
	  the synchronization.

	  WARNING: improper use of this can result in deadlocking kernel
	  drivers from userspace. Intended for test and debug only.

menuconfig DMABUF_HEAPS
	bool "DMA-BUF Userland Memory Heaps"
	select DMA_SHARED_BUFFER
	help
	  Choose this option to enable the DMA-BUF userland memory heaps.
	  This options creates per heap chardevs in /dev/dma_heap/ which
	  allows userspace to allocate dma-bufs that can be shared
	  between drivers.

config DMABUF_PAGE_POOL
	bool "DMA-BUF page-pool library"
	depends on !DMABUF_HEAPS
	help
	  Choose this option to enable the DMA-BUF page-pool library.

source "drivers/dma-buf/heaps/Kconfig"

endmenu
```

## drivers/net/wireless/rockchip_wlan/uwe5621ds/Kconfig
```kconfig
# SPDX-License-Identifier: GPL-2.0

config UWE5621DS
	tristate "UWE5621DS Wi-Fi Driver"
	---help---
		Sprd UWE5621DS Wi-Fi Driver.

if UWE5621DS
source "drivers/net/wireless/rockchip_wlan/uwe5621ds/unisocwcn/Kconfig"
source "drivers/net/wireless/rockchip_wlan/uwe5621ds/tty-sdio/Kconfig"
source "drivers/net/wireless/rockchip_wlan/uwe5621ds/unisocwifi/Kconfig"
endif
```

## drivers/net/wireless/rockchip_wlan/uwe5621ds/tty-sdio/Kconfig
```kconfig
# SPDX-License-Identifier: GPL-2.0
config TTY_OVERY_SDIO
	tristate "Spard TTY Overy SDIO Driver"
	---help---
	  Spard tty overy sdio driver.
```

## drivers/net/wireless/rockchip_wlan/uwe5621ds/unisocwcn/gnss/Kconfig
```kconfig
# SPDX-License-Identifier: GPL-2.0
config MARLIN3_GNSSBAK
	tristate "gnss support"
	default n
	help
	  Debug system for Spreadtrum MARLIN3 GNSS chip
	  If unsure, say n.
```

## drivers/rtl8822cs/Kconfig
```kconfig
config RTL8822BS
	tristate "Realtek 8822C SDIO WiFi"
	---help---
	  Help message of RTL8822CS
```

## kernel/rcu/Kconfig.debug
```kconfig
#
# RCU-related debugging configuration options
#

menu "RCU Debugging"

config PROVE_RCU
	def_bool PROVE_LOCKING

config TORTURE_TEST
	tristate
	default n

config RCU_PERF_TEST
	tristate "performance tests for RCU"
	depends on DEBUG_KERNEL
	select TORTURE_TEST
	select SRCU
	select TASKS_RCU
	default n
	help
	  This option provides a kernel module that runs performance
	  tests on the RCU infrastructure.  The kernel module may be built
	  after the fact on the running kernel to be tested, if desired.

	  Say Y here if you want RCU performance tests to be built into
	  the kernel.
	  Say M if you want the RCU performance tests to build as a module.
	  Say N if you are unsure.

config RCU_TORTURE_TEST
	tristate "torture tests for RCU"
	depends on DEBUG_KERNEL
	select TORTURE_TEST
	select SRCU
	select TASKS_RCU
	default n
	help
	  This option provides a kernel module that runs torture tests
	  on the RCU infrastructure.  The kernel module may be built
	  after the fact on the running kernel to be tested, if desired.

	  Say Y here if you want RCU torture tests to be built into
	  the kernel.
	  Say M if you want the RCU torture tests to build as a module.
	  Say N if you are unsure.

config RCU_CPU_STALL_TIMEOUT
	int "RCU CPU stall timeout in seconds"
	depends on RCU_STALL_COMMON
	range 3 300
	default 21
	help
	  If a given RCU grace period extends more than the specified
	  number of seconds, a CPU stall warning is printed.  If the
	  RCU grace period persists, additional CPU stall warnings are
	  printed at more widely spaced intervals.

config BOOTPARAM_RCU_STALL_PANIC
	bool "Panic (Reboot) On RCU CPU stall timeout"
	depends on RCU_STALL_COMMON
	help
	  Say Y here to enable the kernel to panic on "rcu stall timeout",
	  which are bugs that RCU grace period extends more than 21 seconds
	  (configurable using the RCU_CPU_STALL_TIMEOUT).

	  The panic can be used in combination with panic_timeout,
	  to cause the system to reboot automatically after a
	  stall timeout. This feature is useful for high-availability
	  systems that have uptime guarantees and where a stall timeout
	  must be resolved ASAP.

	  Say N if unsure.

config BOOTPARAM_RCU_STALL_PANIC_VALUE
	int
	depends on RCU_STALL_COMMON
	range 0 1
	default 0 if !BOOTPARAM_RCU_STALL_PANIC
	default 1 if BOOTPARAM_RCU_STALL_PANIC

config RCU_TRACE
	bool "Enable tracing for RCU"
	depends on DEBUG_KERNEL
	default y if TREE_RCU
	select TRACE_CLOCK
	help
	  This option enables additional tracepoints for ftrace-style
	  event tracing.

	  Say Y here if you want to enable RCU tracing
	  Say N if you are unsure.

config RCU_EQS_DEBUG
	bool "Provide debugging asserts for adding NO_HZ support to an arch"
	depends on DEBUG_KERNEL
	help
	  This option provides consistency checks in RCU's handling of
	  NO_HZ.  These checks have proven quite helpful in detecting
	  bugs in arch-specific NO_HZ code.

	  Say N here if you need ultimate kernel/user switch latencies
	  Say Y if you are unsure

endmenu # "RCU Debugging"
```
